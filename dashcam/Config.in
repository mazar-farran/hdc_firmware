## dashcam/Config.in
```kconfig
source "$BR2_EXTERNAL_DASHCAM_PATH/package/camera-api/Config.in"
source "$BR2_EXTERNAL_DASHCAM_PATH/package/camera-bridge/Config.in"
source "$BR2_EXTERNAL_DASHCAM_PATH/package/camera-node/Config.in"
source "$BR2_EXTERNAL_DASHCAM_PATH/package/api-health-manager/Config.in"
source "$BR2_EXTERNAL_DASHCAM_PATH/package/camera-scripts/Config.in"
source "$BR2_EXTERNAL_DASHCAM_PATH/package/data-logger/Config.in"
source "$BR2_EXTERNAL_DASHCAM_PATH/package/led-controller/Config.in"
source "$BR2_EXTERNAL_DASHCAM_PATH/package/lorawan-logger/Config.in"
source "$BR2_EXTERNAL_DASHCAM_PATH/package/onboard-updater/Config.in"
source "$BR2_EXTERNAL_DASHCAM_PATH/package/python-transitions/Config.in"
source "$BR2_EXTERNAL_DASHCAM_PATH/package/zig-aarch64/Config.in"
source "$BR2_EXTERNAL_DASHCAM_PATH/package/folder_purger/Config.in"
source "$BR2_EXTERNAL_DASHCAM_PATH/package/debugger/Config.in"
source "$BR2_EXTERNAL_DASHCAM_PATH/package/hdc-acl/Config.in"
source "$BR2_EXTERNAL_DASHCAM_PATH/package/yolov8/Config.in"
source "$BR2_EXTERNAL_DASHCAM_PATH/package/python-gitpython/Config.in"
source "$BR2_EXTERNAL_DASHCAM_PATH/package/python-scipy/Config.in"
source "$BR2_EXTERNAL_DASHCAM_PATH/package/python-numpy/Config.in"
```

## dashcam/package/camera-bridge/Config.in
```kconfig
config BR2_PACKAGE_CAMERA_BRIDGE
	bool "camera-bridge"
  select BR2_PACKAGE_BOOST
  select BR2_PACKAGE_BOOST_PROGRAM_OPTIONS
  select BR2_PACKAGE_LIBCAMERA
  select BR2_PACKAGE_LIBCAMERA_PIPELINE_RASPBERRYPI
  select BR2_PACKAGE_JPEG
  select BR2_PACKAGE_LIBJPEG
	help
	  The C++ portion of the Capable camera firmware which bridges libcamera.
```

## dashcam/package/camera-cpp/Config.in
```kconfig
config BR2_PACKAGE_CAMERA_CPP
	bool "camera-cpp"
  select BR2_PACKAGE_BOOST
  select BR2_PACKAGE_BOOST_PROGRAM_OPTIONS
  select BR2_PACKAGE_LIBCAMERA
  select BR2_PACKAGE_JPEG
  select BR2_PACKAGE_LIBJPEG
	help
	  The C++ portion of the Capable camera firmware.
```

## dashcam/package/camera-zig/Config.in
```kconfig
config BR2_PACKAGE_CAMERA_ZIG
	bool "camera-zig"
	select BR2_PACKAGE_HOST_ZIG_X86_86
	help
	  The Zig portion of the Capable camera firmware.
```

## dashcam/package/file_mover/Config.in
```kconfig
config BR2_PACKAGE_FILE_MOVER
	bool "file-mover"
	help
	  General utility scripts
```

## dashcam/package/gma_loader/Config.in
```kconfig
config BR2_PACKAGE_GMA_LOADER
	bool "gma-loader"
	help
	  General utility scripts
```

## dashcam/package/hellozig/Config.in
```kconfig
config BR2_PACKAGE_HELLOZIG
	bool "hellozig"
	select BR2_PACKAGE_HOST_ZIG_X86_86
	help
	  Test program.
```

## dashcam/package/hivemapper-edge-privacy/Config.in
```kconfig
config BR2_PACKAGE_HIVEMAPPER_EDGE_PRIVACY
	bool "hivemapper-edge-privacy"
  select BR2_PACKAGE_PYTHON3
```

## dashcam/package/mga_loader/Config.in
```kconfig
config BR2_PACKAGE_MGA_LOADER
	bool "mga-loader"
	help
	  General utility scripts
```

## dashcam/package/onboard-updater/Config.in
```kconfig
config BR2_PACKAGE_ONBOARD_UPDATER
	bool "onboard-updater"
  select BR2_PACKAGE_PYTHON3
	help
	  The onboard updater that manages the OTAU.
```

## dashcam/package/onnx-yolov8-object-detection/Config.in
```kconfig
config BR2_PACKAGE_ONNX_YOLOV8_OBJECT_DETECTION
	bool "onnx-yolov8-object-detection"
  select BR2_PACKAGE_PYTHON3
```

## dashcam/package/python-inotify/Config.in
```kconfig
config BR2_PACKAGE_PYTHON_INOTIFY
	bool "python-inotify"
	select BR2_PACKAGE_PYTHON3
```

## dashcam/package/python-opencv-python/Config.in
```kconfig
config BR2_PACKAGE_PYTHON_OPENCV_PYTHON
	bool "python-opencv-python"
	select BR2_PACKAGE_PYTHON3
	select BR2_PACKAGE_OPENCV3_LIB_PYTHON
	select BR2_PACKAGE_READLINE
	select BR2_PACKAGE_PYTHON_WHEEL
	select BR2_PACKAGE_PYTHON_DISTRO
	select BR2_PACKAGE_PYTHON_SCIKIT_BUILD
```

## dashcam/package/python-psutil/Config.in
```kconfig
config BR2_PACKAGE_PYTHON_PSUTIL
	bool "python-psutil"
	select BR2_PACKAGE_PYTHON_SIX # runtime
```

## dashcam/package/python-scipy/Config.in
```kconfig
config BR2_PACKAGE_PYTHON_SCIPY
	bool "python-scipy"
	select BR2_PACKAGE_PYTHON_SIX # runtime
```

## dashcam/package/python-torchvision/Config.in
```kconfig
config BR2_PACKAGE_PYTHON_TORCHVISION
	bool "python-torchvision"
	select BR2_PACKAGE_PYTHON_TORCHVISION # runtime
```

## dashcam/package/yolov8/Config.in
```kconfig
config BR2_PACKAGE_YOLOV8
	bool "yolov8"
    select BR2_PACKAGE_PYTHON3
	select BR2_PACKAGE_PYTHON_REQUESTS
	select BR2_PACKAGE_PYTHON_GITPYTHON
	select BR2_PACKAGE_PYTHON_MATPLOTLIB
	select BR2_PACKAGE_PYTHON_PILLOW
	select BR2_PACKAGE_PYTHON_PSUTIL
	select BR2_PACKAGE_PYTHON_PYBIND11
	select BR2_PACKAGE_PYTHON_PYYAML
	select BR2_PACKAGE_PYTHON_ULTRALYTICS
	select BR2_PACKAGE_OPENCV4
	select BR2_PACKAGE_OPENCV4_LIB_PYTHON
	select BR2_PACKAGE_PYTHON_PIP
	select BR2_PACKAGE_PYTHON_PROTOBUF
	select BR2_PACKAGE_PYTHON_SYMPY
	select BR2_PACKAGE_PYTHON_MPMATH
	select BR2_PACKAGE_PYTHON_HUMANFRIENDLY
	select BR2_PACKAGE_PYTHON_NUMPY
	# dependencies for opencv_python
	select BR2_PACKAGE_READLINE
	select BR2_PACKAGE_PYTHON_WHEEL
	select BR2_PACKAGE_PYTHON_DISTRO
	select BR2_PACKAGE_PYTHON_SCIKIT_BUILD
	# dependencies for opencv_python
	help
	  Yolov8 package dependencies
```

## dashcam/package/zig-aarch64/Config.in
```kconfig
config BR2_PACKAGE_ZIG_AARCH64
	bool "zig-aarch64-target"
	help
	  Zig for the AARCH64 target.
```
