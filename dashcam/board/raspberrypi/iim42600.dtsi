&invn_spi {
	#address-cells = <1>;
	#size-cells = <0>;

	invn_icm_spi: iim42600@0 {
		compatible = "invensense,iim42600";
		reg = <0>;
		interrupts = <0 IRQ_TYPE_EDGE_RISING>;
		spi-max-frequency = <24000000>;
		spi-cpol;
		spi-cpha;
		inven,vdd_ana-supply = <&invn_vdd>;
		inven,vcc_i2c-supply = <&invn_vddio>;
		axis_map_x = <0>;
		axis_map_y = <1>;
		axis_map_z = <2>;
		negate_x = <0>;
		negate_y = <0>;
		negate_z = <0>;
		inven,secondary_type = "none";
		inven,aux_type = "none";
		inven,read_only_slave_type = "none";
	};
};
